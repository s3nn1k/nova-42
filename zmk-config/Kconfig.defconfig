## zmk-config/Kconfig.defconfig
```kconfig
# Copyright (c) 2026 The ZMK Contributors
# SPDX-License-Identifier: MIT

if SHIELD_NOVA42_LEFT

config ZMK_KEYBOARD_NAME
    default "Nova42"

config ZMK_SPLIT_ROLE_CENTRAL
    default y

endif

if SHIELD_NOVA42_LEFT || SHIELD_NOVA42_RIGHT

config ZMK_SPLIT
    default y

endif
```

## zmk-config/Kconfig.shield
```kconfig
# Copyright (c) 2026 The ZMK Contributors
# SPDX-License-Identifier: MIT

config SHIELD_NOVA42_LEFT
    def_bool $(shields_list_contains,nova42_left)

config SHIELD_NOVA42_RIGHT
    def_bool $(shields_list_contains,nova42_right)
```
